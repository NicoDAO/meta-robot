## conf/layer.conf
```bitbake
# We have a conf and classes directory, add to BBPATH
BBPATH .= ":${LAYERDIR}"

# We have recipes-* directories, add to BBFILES
BBFILES += "${LAYERDIR}/recipes-*/*/*.bb \
            ${LAYERDIR}/recipes-*/*/*.bbappend"

BBFILE_COLLECTIONS += "meta-robot"
BBFILE_PATTERN_meta-robot = "^${LAYERDIR}/"
BBFILE_PRIORITY_meta-robot = "6"

LAYERSERIES_COMPAT_robot-layer = "thud warrior zeus"
LAYERDEPENDS_robot-layer = "core"

LICENSE_PATH += "${LAYERDIR}/licenses"
```
